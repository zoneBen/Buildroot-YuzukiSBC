## buildroot/board/bingpi/bingpi/config/uboot/uboot_bingpi_defconfig
```kconfig
CONFIG_ARM=y
CONFIG_ARCH_SUNXI=y
CONFIG_SPL=y
CONFIG_MACH_SUN8I_V3S=y
CONFIG_DRAM_CLK=360
CONFIG_BOOTDELAY=3
CONFIG_CMD_NVEDIT_EFI=y
CONFIG_DEFAULT_DEVICE_TREE="sun8i-v3s-bingpi-uboot"
CONFIG_TFTP_BLOCKSIZE=512
CONFIG_DM_VIDEO=y
CONFIG_DISPLAY=y
CONFIG_VIDEO_DE2=y
CONFIG_VIDEO_LCD_DCLK_PHASE=1
CONFIG_DM_PWM=y
CONFIG_PWM_SUNXI=y
CONFIG_DM_REGULATOR=y
CONFIG_DM_REGULATOR_FIXED=y
CONFIG_BACKLIGHT_PWM=y
CONFIG_CONSOLE_MUX=y
# CONFIG_NETDEVICES is not set
```
